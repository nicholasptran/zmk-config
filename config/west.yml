## config/west.yml
```yaml
manifest:
  defaults:
    revision: v0.4
  remotes:
    - name: zmkfirmware
      url-base: https://github.com/zmkfirmware
    - name: nicholasptran
      url-base: https://github.com/nicholasptran
  projects:
    - name: zmk
      remote: zmkfirmware
      revision: release-please--branches--main
      import: app/west.yml
    - name: zmk-keyboard-keyball
      remote: nicholasptran
      revision: main
      import: west.yml
  self:
    path: config
```
